AUTOSAR XML (schema 4-3-0)
package /ComponentTypes
  composition sw component type Implementation
    4 x component:
      edres: type=aa
      sersf: type=bb
      vcvcfd: type=aa
      vbvbd: type=bb
